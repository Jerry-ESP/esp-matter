## awox_light/common/TargetConfig/Kconfig.projbuild
```kconfig
menu "Awox Target Configuration"

    menu "Device information"
        config MODEL_NAME
            string "Model Name"
            default "GenericName"
            help
                Type the name of your product

        config PRODUCT_ID
            hex "Product ID"
            default 0x0000
            range 0x0000 0xFFFF
            help
                Type the product id of your device

    endmenu

    config SKIP_PRODUCTION
        bool "Skip production"
        default false
        help
            Select if you want to skip production mode

    config USE_REGISTERED_MAC
        bool "Use registered MAC"
        default false
        help
            Select if you want to use a registered MAC address (TEST ONLY)

    choice APPLICATION_TYPE
    prompt "Device application"
    help
        Set the Zigbee target selector to define clusters and endpoints. Should not be changed, it is retrieved from Product Database
        
    config TARGET_DIMMABLE
        bool "DIMMABLE"
    config TARGET_TW
        bool "TW"
    config TARGET_RGBTW
        bool "RGBTW"
    config TARGET_RGBW
        bool "RGBW"
    config TARGET_RGBIC
        bool "RGBIC"
    config TARGET_RCU
        bool "RCU"
    config TARGET_RCU_3G
        bool "RCU3G"
    config TARGET_PIR
        bool "PIR"
    config TARGET_BLFL
        bool "BLFL"
    endchoice

    menu "Hardware version"
        choice ModuleVersion
        prompt "Module Version"
        help
            Module Version selection:

            Each device can operate on different hw version. Each version of module changes the GPIO mapping.

        config MODULE_VERSION_WROOM_07
            bool "ESP32-H2-WROOM-07"
        config MODULE_VERSION_MINI_1
            bool "ESP32H2-MINI-1"
        config MODULE_VERSION_DEVKIT
            bool "Development Kit"
        config MODULE_VERSION_COB_GENERIC_TW
            bool "COB Generic TW"
        config MODULE_VERSION_COB_GENERIC_RGBTW
            bool "COB Generic RGBTW"
        config MODULE_VERSION_COB_GENERIC_RGBW
            bool "COB Generic RGB W"
        endchoice

        config HARDWARE_VERSION_MAJOR
            int "Major number of HW version"
            default 0
            range 0 255
            help
                Type the major number of the hardware version

        config HARDWARE_VERSION_MINOR
            int "Minor number of HW version"
            default 0
            range 0 255
            help
                Type the minor number of the hardware version
    endmenu

    menu "Firmware version"
        config FIRMWARE_VERSION
            string "FW version"
            default "0.0.0"
            help
                Type the FW version for your device

        config FIRMWARE_VERSION_MAJOR
            int "Major number of FW version"
            default 0
            range 0 255
            help
                Type the major number of the firmware version

        config FIRMWARE_VERSION_MINOR
            int "Minor number of FW version"
            default 0
            range 0 255
            help
                Type the minor number of the firmware version

        config FIRMWARE_VERSION_PATCH
            int "Patch number of FW version"
            default 0
            range 0 255
            help
                Type the patch number of the firmware version

        config FIRMWARE_VERSION_BUILD
            int "Build number of FW version"
            default 0
            range 0 65535
            help
                Type the build number of the firmware version
    endmenu

    menu "White temperature range"
        config MIN_TEMPERATURE_MIREDS
            int "Min mireds temperature"
            default 153
            range 100 1000
            help
                Type the minimum mireds temperature of your device

        config MAX_TEMPERATURE_MIREDS
            int "Max mireds temperature"
            default 370
            range 100 1000
            help
                Type the maximum mireds temperature of your device
    endmenu

    menu "PWM configuration"
        config PWM_FREQUENCY
            int "PWM frequency"
            default 16000
            range 1000 20000
            help
                Type the PWM frequency of your device

        config MIN_PWM_CW
            int "Minimum of PWM for cold white LED"
            default 10
            range 1 1000
            help
                Type the minimum of PWM for cold white LED

        config MIN_PWM_WW
            int "Minimum of PWM for warm white LED"
            default 10
            range 1 1000
            help
                Type the minimum of PWM for warm white LED

        config MIN_PWM_R
            int "Minimum of PWM for red LED"
            default 10
            range 1 1000
            help
                Type the minimum of PWM for red LED

        config MIN_PWM_G
            int "Minimum of PWM for green LED"
            default 10
            range 1 1000
            help
                Type the minimum of PWM for green LED
                
        config MIN_PWM_B
            int "Minimum of PWM for blue LED"
            default 10
            range 1 1000
            help
                Type the minimum of PWM for blue LED
                
        config INVERTED_PWM_CW
            bool "Inversion of cold white PWM"
            default False
            help
                Select if cold white PWM is inverted

        config INVERTED_PWM_WW
            bool "Inversion of warm white PWM"
            default False
            help
                Select if warm white PWM is inverted

        config INVERTED_PWM_R
            bool "Inversion of red PWM"
            default False
            help
                Select if red PWM is inverted

        config INVERTED_PWM_G
            bool "Inversion of green PWM"
            default False
            help
                Select if green PWM is inverted
                
        config INVERTED_PWM_B
            bool "Inversion of blue PWM"
            default False
            help
                Select if blue PWM is inverted
    endmenu

    menu "Connectivities"
        config EMULATE_TELINK_ADDR
            bool "Emulate Telink ADDR"
            default false
            help
                Select if BLE address is like Telink ones

        config CONNECTIVITY_BLE
            bool "BLE support"
            default False
            help
                Select if BLE is supported in your device

        config CONNECTIVITY_ZIGBEE
            bool "Zigbee support"
            default False
            help
                Select if Zigbee is supported in your device

        config CONNECTIVITY_BEACON
            bool "Beacon support"
            default False
            help
                Select if Bluetooth beacons is supported in your device

        config CONNECTIVITY_MATTER
            bool "Matter support"
            default False
            help
                Select if Matter is supported in your device
    endmenu

    menu "Capabilities"
        config CAPABILITY_SWITCH
            bool "ON/OFF support"
            default False
            help
                Select if ON/OFF is supported in your device

        config CAPABILITY_WHITE
            bool "White support"
            default False
            help
                Select if white is supported in your device

        config CAPABILITY_DIMMING
            bool "Dimming support"
            default False
            help
                Select if dimming is supported in your device

        config CAPABILITY_TEMPERATURE
            bool "Temperature support"
            default False
            help
                Select if color temperature is supported in your device

        config CAPABILITY_COLOR
            bool "RGB color support"
            default False
            help
                Select if RGB color is supported in your device

        config CAPABILITY_BACKLIGHT
            bool "Backlight support"
            default False
            help
                Select if backlight feature is supported in your device

        config CAPABILITY_CONTROLLER_PLUG_IN
            bool "Controlleur plug-in support"
            default False
            help
                Select if your device is a plug-in controller

        config CAPABILITY_RCUGROUPS
            bool "RCU with multiple groups support"
            default False
            help
                Select if your RCU support multiple groups

        config CAPABILITY_RCU
            bool "RCU support"
            default False
            help
                Select if your device can control other devices

        config CAPABILITY_MOTION
            bool "Motion detection support"
            default False
            help
                Select if motion detection is supported in your device

        config CAPABILITY_I2C
            bool "I2C support"
            default False
            help
                Select if I2C is supported in your device
    endmenu


endmenu
```

## awox_light/light_cw_pwm/sdkconfig.defaults.esp32h2
```kconfig
CONFIG_IDF_TARGET="esp32h2"

# libsodium
CONFIG_LIBSODIUM_USE_MBEDTLS_SHA=y

# NIMBLE
CONFIG_BT_ENABLED=y
CONFIG_BT_NIMBLE_ENABLED=y
CONFIG_BT_NIMBLE_EXT_ADV=n
CONFIG_BT_NIMBLE_HCI_EVT_BUF_SIZE=70
CONFIG_USE_BLE_ONLY_FOR_COMMISSIONING=n

# FreeRTOS should use legacy API
CONFIG_FREERTOS_ENABLE_BACKWARD_COMPATIBILITY=y

# Enable OpenThread
CONFIG_OPENTHREAD_ENABLED=y
CONFIG_OPENTHREAD_SRP_CLIENT=y
CONFIG_OPENTHREAD_DNS_CLIENT=y
CONFIG_OPENTHREAD_LOG_LEVEL_DYNAMIC=n
CONFIG_OPENTHREAD_LOG_LEVEL_NOTE=y
CONFIG_OPENTHREAD_CLI=n


# Disable lwip ipv6 autoconfig
CONFIG_LWIP_IPV6_AUTOCONFIG=n

# Use a custom partition table
CONFIG_PARTITION_TABLE_CUSTOM=y
CONFIG_PARTITION_TABLE_CUSTOM_FILENAME="../common/TargetConfig/partitions_4MB.csv"

# LwIP config for OpenThread
CONFIG_LWIP_IPV6_NUM_ADDRESSES=8
CONFIG_LWIP_MULTICAST_PING=y

# MDNS platform
CONFIG_USE_MINIMAL_MDNS=n
CONFIG_ENABLE_EXTENDED_DISCOVERY=y

# Enable OTA Requestor
CONFIG_ENABLE_OTA_REQUESTOR=y

# Disable STA and AP for ESP32H2
CONFIG_ENABLE_WIFI_STATION=n
CONFIG_ENABLE_WIFI_AP=n

# Enable chip shell
CONFIG_ENABLE_CHIP_SHELL=n

# Disable persist subscriptions
CONFIG_ENABLE_PERSIST_SUBSCRIPTIONS=n

# MRP configs
CONFIG_MRP_LOCAL_ACTIVE_RETRY_INTERVAL_FOR_THREAD=5000
CONFIG_MRP_LOCAL_IDLE_RETRY_INTERVAL_FOR_THREAD=5000
CONFIG_MRP_RETRY_INTERVAL_SENDER_BOOST_FOR_THREAD=5000
CONFIG_MRP_MAX_RETRANS=3

# Enable External Platform
CONFIG_CHIP_ENABLE_EXTERNAL_PLATFORM=y
CONFIG_CHIP_EXTERNAL_PLATFORM_DIR="../../../../awox_light/common/platform/ESP32_custom"
CONFIG_CHIP_EXTERNAL_PLATFORM_INCLUDE_DIR="../../../../awox_light/common/"

CONFIG_BT_NIMBLE_EXT_ADV=y

CONFIG_PRODUCT_ID=0x6097
CONFIG_MODEL_NAME="EGLO-ZMB-TW"
CONFIG_DEVICE_TYPE=light
CONFIG_HARDWARE_VERSION_MAJOR=6
CONFIG_HARDWARE_VERSION_MINOR=00
CONFIG_FIRMWARE_VERSION="1.0.0"
CONFIG_FIRMWARE_VERSION_MAJOR=1
CONFIG_FIRMWARE_VERSION_MINOR=0
CONFIG_FIRMWARE_VERSION_PATCH=0

CONFIG_MODULE_VERSION_DEVKIT=y

#
# Drivers
#
CONFIG_ENABLE_PWM_DRIVER=y
# CONFIG_PWM_ENABLE_HW_FADE is not set
CONFIG_ENABLE_SM2135EH_DRIVER=n
CONFIG_ENABLE_SM2x35EGH_DRIVER=n
CONFIG_ENABLE_BP57x8D_DRIVER=n
CONFIG_ENABLE_BP1658CJ_DRIVER=n
CONFIG_ENABLE_KP18058_DRIVER=n
CONFIG_ENABLE_WS2812_DRIVER=n

#
#Factory Data Provider
#
CONFIG_ENABLE_ESP32_FACTORY_DATA_PROVIDER=y
CONFIG_ENABLE_ESP32_DEVICE_INSTANCE_INFO_PROVIDER=y
CONFIG_ENABLE_ESP32_DEVICE_INFO_PROVIDER=y
CONFIG_ESP_MATTER_COMMISSIONABLE_DATA_PROVIDER=y
CONFIG_ESP_MATTER_DEVICE_INSTANCE_INFO_PROVIDER=y
CONFIG_CHIP_FACTORY_NAMESPACE_PARTITION_LABEL="fctry"

#
#Use secure cert DAC provider
#
CONFIG_SEC_CERT_DAC_PROVIDER=y

#
#Use custom certifica declaration
#
CONFIG_ENABLE_SET_CERT_DECLARATION_API=y

#
#Disable DS_PERIPHERAL only for test
#
CONFIG_ESP_SECURE_CERT_DS_PERIPHERAL=n
CONFIG_USE_ESP32_ECDSA_PERIPHERAL=n

# Enable DS Peripheral
#CONFIG_ESP_SECURE_CERT_DS_PERIPHERAL=y

#
# Bootloader config (Custom)
#
CONFIG_BOOTLOADER_COMPRESSED_ENABLED=y
CONFIG_BOOTLOADER_DECOMPRESSOR_XZ=y
CONFIG_BOOTLOADER_LOG_LEVEL=0
CONFIG_BOOTLOADER_LOG_LEVEL_NONE=y
CONFIG_BOOTLOADER_SKIP_VALIDATE_ON_POWER_ON=n # If set to "y" will go faster but can be risky

#
# Security options
#
#CONFIG_SECURE_FLASH_ENC_ENABLED=y
#CONFIG_NVS_ENCRYPTION=y
#CONFIG_SECURE_FLASH_SKIP_WRITE_PROTECTION_CACHE=y
#CONFIG_SECURE_FLASH_ENCRYPTION_MODE_DEVELOPMENT=y
#CONFIG_SECURE_INSECURE_ALLOW_DL_MODE=y
#CONFIG_SECURE_FLASH_UART_BOOTLOADER_ALLOW_ENC=y
#CONFIG_SECURE_SIGNED_ON_BOOT=y
#CONFIG_SECURE_SIGNED_ON_UPDATE=y
#CONFIG_SECURE_SIGNED_APPS=y
#CONFIG_SECURE_BOOT_V2_RSA_SUPPORTED=y
#CONFIG_SECURE_BOOT_V2_PREFERRED=y
#CONFIG_SECURE_BOOT=y
#CONFIG_SECURE_BOOT_V2_ENABLED=y
#CONFIG_SECURE_SIGNED_APPS_RSA_SCHEME=y
#CONFIG_SECURE_BOOT_BUILD_SIGNED_BINARIES=y
#CONFIG_SECURE_BOOT_SIGNING_KEY="../TargetConfig/secure_boot_signing_key.pem"
```

## components/board/Kconfig.projbuild
```kconfig
menu "ESP Matter Board Selection"

    choice BOARD_NAME
        prompt "Board name"
        default BOARD_NAME_ESP32_DEVKIT_C if IDF_TARGET_ESP32
        default BOARD_NAME_ESP32C3_DEVKIT_M if IDF_TARGET_ESP32C3
        help
            Board name from esp-matter/components/board

        config BOARD_NAME_ESP32_DEVKIT_C
            bool "esp32_devkit_c"
            depends on IDF_TARGET_ESP32

        config BOARD_NAME_ESP32C3_DEVKIT_M
            bool "esp32c3_devkit_m"
            depends on IDF_TARGET_ESP32C3

        config BOARD_NAME_M5STACK
            bool "m5stack"
            depends on IDF_TARGET_ESP32

        config BOARD_NAME_HOLLOW
            bool "hollow"
    endchoice

    config BOARD_NAME
        string
        default "esp32_devkit_c" if BOARD_NAME_ESP32_DEVKIT_C
        default "esp32c3_devkit_m" if BOARD_NAME_ESP32C3_DEVKIT_M
        default "m5stack" if BOARD_NAME_M5STACK
        default "hollow" if BOARD_NAME_HOLLOW

    config LED_DRIVER
        string
        default "gpio" if BOARD_NAME_ESP32_DEVKIT_C
        default "rmt" if BOARD_NAME_ESP32C3_DEVKIT_M
        default "vled" if BOARD_NAME_M5STACK
        default "hollow" if LED_DRIVER_HOLLOW

    config BUTTON_DRIVER
        string
        default "hollow"

endmenu
```

## examples/controller/main/Kconfig
```kconfig
menu "ESP Matter Rework"

    choice REWORK_DEVICE_TYPE
        prompt "Rework device type"
        default THREAD_DEVICE
        help
            This option determines which type need be rework.

        config THREAD_DEVICE
            bool "Rework openthread device"
            help
                Rework openthread device

        config WIFI_DEVICE
            bool "Rework wifi device"
            help
                Rework wifi device

    endchoice

    config ENABLE_DAC_UPDATE
        bool "Rework enable DAC update"
        default n
        help
            Enable DAC update.

    config NEW_SOFTWARE_VERSION
        int "New software version"
        default 10010001
            help
                New software version number for the rework device.

    config NEW_SOFTWARE_VERSION_STRING
        string "New software version string"
        default "1.1.1-660"
        help
            New software version string for the rework device.

endmenu
```
